## boards/arm/le_jlwffre/Kconfig.defconfig
```kconfig
# Copyright (c) 2020 The ZMK Contributors
# SPDX-License-Identifier: MIT

if BOARD_LE_JLWFFRE

config ZMK_KEYBOARD_NAME
	default "le_jlwffre"

if USB

config USB_NRFX
	default y

config USB_DEVICE_STACK
	default y

endif # USB

config BT_CTLR
	default BT

config ZMK_BLE
	default y

config ZMK_USB
	default y

config I2C
	default y

config MAX17048
	default y

endif # BOARD_LE_JLWFFRE
```
